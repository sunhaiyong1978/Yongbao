## loongarch64/scripts/step/DE-KDE/kconfig
```kconfig
source env/DE-KDE/config
source env/distro.info
source env/function.sh
export STEP_BUILDNAME=DE-KDE
export STEP_PACKAGENAME=kconfig
export PACKAGE_VERSION=5.113.0
export RESOURCEDIR=${NEW_TARGET_SYSDIR}/files/DE-KDE/kconfig/5.113.0/
rm -rf ${BUILD_DIRECTORY}/kconfig-5.113.0
tar xvf ${DOWNLOADDIR}/kconfig-5.113.0.tar.xz -C ${BUILD_DIRECTORY} 
pushd ${BUILD_DIRECTORY}/kconfig-5.113.0
        
        mkdir cross-build
        pushd cross-build
                CC="${CROSS_TARGET}-gcc" CXX="${CROSS_TARGET}-g++" \
                cmake -G "Unix Makefiles" -DCMAKE_BUILD_TYPE=Release -DCMAKE_CROSSCOMPILING_EMULATOR=qemu-loongarch64 \
                      -DPKG_CONFIG_EXECUTABLE=${SYSDIR}/cross-tools/bin/${CROSS_TARGET}-pkg-config \
                      -DCMAKE_SYSROOT=${SYSDIR}/sysroot \
                      -DCMAKE_FIND_ROOT_PATH=${SYSDIR}/sysroot/usr \
                      -DGETTEXT_MSGFMT_EXECUTABLE=/bin/msgfmt \
                      -DGETTEXT_MSGMERGE_EXECUTABLE=/bin/msgmerge \
                      -DPython_EXECUTABLE=${CROSSTOOLS_DIR}/bin/python3 \
                      -DPYTHON_EXECUTABLE=${CROSSTOOLS_DIR}/bin/python3 \
                      -DPYTHON3_EXECUTABLE=${CROSSTOOLS_DIR}/bin/python3 \
                      -DPERL_EXECUTABLE=${SYSDIR}/cross-tools/bin/${CROSS_TARGET}-perl \
                      -DRuby_EXECUTABLE=${SYSDIR}/cross-tools/bin/ruby \
                      -DGPERF_EXECUTABLE=/bin/gperf -DGperf_EXECUTABLE=/bin/gperf \
                      -DDOXYGEN_EXECUTABLE=/bin/doxygen \
                      -DCMAKE_INSTALL_LIBDIR=/usr/lib64 -DLIB_SUFFIX=64 \
                      -DCMAKE_INSTALL_PREFIX=/usr \
                      -DBUILD_SHARED_LIBS=ON \
		      -DBUILD_TESTING=OFF \
                      -Wno-dev ..
                eval ${MAKE_AND_INSTALL}
        popd
        rm -f ${SYSROOT_DIR}/usr/lib64/*.la
popd 
rm -rf ${BUILD_DIRECTORY}/kconfig-5.113.0

mkdir -pv ${CROSSTOOLS_DIR}/qt5/libexec/kf5
echo "qemu-loongarch64 ${SYSROOT_DIR}/usr/lib${LIB_SUFF}/libexec/kf5/kconfig_compiler_kf5 \"\$@\"" \
	> ${CROSSTOOLS_DIR}/qt5/libexec/kf5/kconfig_compiler_kf5
echo "qemu-loongarch64 ${SYSROOT_DIR}/usr/lib${LIB_SUFF}/libexec/kf5/kconf_update \"\$@\"" \
	> ${CROSSTOOLS_DIR}/qt5/libexec/kf5/kconf_update
chmod +x ${CROSSTOOLS_DIR}/qt5/libexec/kf5/{kconf_update,kconfig_compiler_kf5}
```
